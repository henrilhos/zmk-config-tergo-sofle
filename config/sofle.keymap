/*
 * Copyright (c) 2020 The ZMK Contributors
 *
 * SPDX-License-Identifier: MIT
 */

// Miryoku (https://github.com/manna-harbour/miryoku_zmk) copiado em config/miryoku.
// As opções ficam em miryoku/custom_config.h e o mapeamento das teclas em miryoku/sofle_mapping.h.
#include "miryoku/custom_config.h"
#include "miryoku/sofle_mapping.h"
#include "miryoku/miryoku.dtsi"

// Combos do teclado. As posições são as 60 do Sofle: 52-54 são os polegares internos da
// esquerda e 55-57 os da direita, e 14 15 / 20 21 / 38 39 / 46 47 são pares de letras do 3x5.
/ {
    combos {
        compatible = "zmk,combos";

        combo_unlock_zmk_studio {
            timeout-ms = <50>;
            key-positions = <52 57>; // polegares externos ativos (Esc e Delete)
            bindings = <&studio_unlock>;
        };

        // Combos de digitação, só na camada Base para não colidir com setas/símbolos das outras
        combo_esc {
            timeout-ms = <30>;
            key-positions = <14 15>; // W + E
            bindings = <&kp ESC>;
            layers = <U_BASE>;
        };
        combo_tab {
            timeout-ms = <30>;
            key-positions = <38 39>; // X + C
            bindings = <&kp TAB>;
            layers = <U_BASE>;
        };
        combo_backspace {
            timeout-ms = <30>;
            key-positions = <20 21>; // I + O
            bindings = <&kp BSPC>;
            layers = <U_BASE>;
        };
        combo_enter {
            timeout-ms = <30>;
            key-positions = <46 47>; // , + .
            bindings = <&kp ENTER>;
            layers = <U_BASE>;
        };
    };
};

// Knobs: o esquerdo controla o volume e o direito faz PgUp/PgDn, em todas as camadas
#define MIRYOKU_X(LAYER, STRING) \
    LAYER { \
        sensor-bindings = <&inc_dec_kp C_VOL_UP C_VOL_DN &inc_dec_kp PG_UP PG_DN>; \
    };
/ {
    keymap {
        MIRYOKU_LAYER_LIST
    };
};
#undef MIRYOKU_X
